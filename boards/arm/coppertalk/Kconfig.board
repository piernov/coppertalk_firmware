## boards/arm/coppertalk/Kconfig.board
```kconfig
# CopperTalk board configuration

# Copyright (c) 2022 piernov
# SPDX-License-Identifier: Apache-2.0

config BOARD_COPPERTALK
	bool "CopperTalk Board"
	depends on SOC_STM32F107XC
	select USE_STM32_HAL_GPIO
	select USE_STM32_HAL_CORTEX
```

## boards/arm/coppertalk/Kconfig.defconfig
```kconfig
# CopperTalk board configuration

# Copyright (c) 2022 piernov
# SPDX-License-Identifier: Apache-2.0

if BOARD_COPPERTALK

config BOARD
	default "coppertalk"

endif # BOARD_COPPERTALK
```

## boards/arm/coppertalk/coppertalk_defconfig
```kconfig
# SPDX-License-Identifier: Apache-2.0

CONFIG_BOARD_COPPERTALK=y
CONFIG_SOC_SERIES_STM32F1X=y
CONFIG_SOC_STM32F107XC=y

# enable uart driver
CONFIG_SERIAL=y
# enable console
CONFIG_CONSOLE=y
CONFIG_UART_CONSOLE=y

# enable GPIO
CONFIG_GPIO=y

# enable clock
CONFIG_CLOCK_CONTROL=y

# enable pin controller
CONFIG_PINCTRL=y

CONFIG_CLOCK_STM32_MCO1_SRC_HSE=y

# Ethernet
CONFIG_NET_L2_ETHERNET=y
CONFIG_ETH_STM32_HAL=y
CONFIG_ETH_STM32_HAL_PHY_ADDRESS=0

# USB
CONFIG_USB_DEVICE_STACK=n
CONFIG_USB_COMPOSITE_DEVICE=n

# Bootloader/USB DFU
#CONFIG_USB_DFU_CLASS=y
#CONFIG_FLASH=y
#CONFIG_IMG_MANAGER=y
#CONFIG_FLASH_PAGE_LAYOUT=y
#CONFIG_BOOTLOADER_MCUBOOT=y
```
